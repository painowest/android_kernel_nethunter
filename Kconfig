## Kconfig
```kconfig
menu "NetHunter Support"

config NETHUNTER_SUPPORT
	bool "Basic nethunter support"
	default n
	help
		Enable basic nethunter support in-kernel which are sysvipc, module support, and mac80211 support.

	select SYSVIPC
	select MODULES
	select MODULE_UNLOAD
	select MODVERSIONS
	select MMC
	select CFG80211_WEXT
	select MAC80211
	select MAC80211_MESH
	select MAC80211_RC_MINSTREL
	select MAC80211_RC_MINSTREL_HT
	select MAC80211_RC_MINSTREL_VHT
	
config NETHUNTER_ETHERNET_SUPPORT
	tristate "Ethernet drivers support"
	default y if NETHUNTER_SUPPORT
	depends on NETHUNTER_SUPPORT
	help
		Enable rtl ethernet drivers support.

	select USB_RTL8150
	select USB_RTL8152
	
config NETHUNTER_USB_SUPPORT
	tristate "USB support"
	default y if NETHUNTER_SUPPORT
	depends on NETHUNTER_SUPPORT
	help
		Enable USB support for nethunter usage like otg access, mtp, rndis and eem.

	select USB_OTG
	select USB_MON
	select USB_XHCI_HCD
	select USB_EHCI_HCD
	select USB_ACM
	select USB_STORAGE
	select USB_SERIAL
	select USB_SERIAL_CH341
	select USB_SERIAL_CP210X
	select USB_SERIAL_FTDI_SIO
	select USB_SERIAL_PL2303
	select USB_GADGET
	select USB_CONFIGFS_SERIAL
	select USB_CONFIGFS_ACM
	select USB_CONFIGFS_OBEX
	select USB_CONFIGFS_NCM
	select USB_CONFIGFS_ECM_SUBSET
	select USB_CONFIGFS_RNDIS
	select USB_CONFIGFS_EEM
	select USB_CONFIGFS_MASS_STORAGE

config NETHUNTER_WIFI_DRIVERS_SUPPORT
	tristate "WiFi drivers support"
	default y if NETHUNTER_SUPPORT
	depends on NETHUNTER_SUPPORT
	help
		Enable ath9k, mt7601, ralink, and realtek drivers support.

	select WLAN_VENDOR_ATH
	select ATH9K_HTC
	select CARL9170
	select ATH6KL
	select ATH6KL_USB
	select LIBERTAS
	select WLAN_VENDOR_MEDIATEK
	select MT7601U
	select WLAN_VENDOR_RALINK
	select RT2X00
	select RT2500USB
	select RT73USB
	select RT2800USB
	select RT2800USB_RT33XX
	select RT2800USB_RT35XX
	select RT2800USB_RT3573
	select RT2800USB_RT53XX
	select RT2800USB_RT55XX
	select RT2800USB_UNKNOWN
	select WLAN_VENDOR_REALTEK
	select RTL8187
	select RTL_CARDS
	select RTL8192CU
	select RTL8XXXU
	select RTL8XXXU_UNTESTED

endmenu
```
